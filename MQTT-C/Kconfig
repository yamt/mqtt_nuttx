## MQTT-C/Kconfig
```kconfig
#
# For a description of the syntax of this configuration file,
# see the file kconfig-language.txt in the NuttX tools repository.
#

config EXTERNALS_MQTTC
	bool "MQTT-C"
	default n
	---help---
		A portable MQTT C client for embedded systems and PCs alike.
		https://github.com/LiamBindle/MQTT-C
```

## mbedtls/Kconfig
```kconfig
#
# For a description of the syntax of this configuration file,
# see the file kconfig-language.txt in the NuttX tools repository.
#

config EXTERNALS_MBEDTLS
	bool "mbed TLS Library"
	default n
	select CLOCK_MONOTONIC
	select NET
	select NET_TCP
	select NET_SOCKOPTS
	select LIBC_NETDB
	---help---
		Enable mbed TLS Library.
		And when you select this, make sure CONFIG_LTE_NET_MBEDTLS is disabled. Those are exclusive items.
		ARM mbed TLS is provided from https://github.com/ARMmbed/mbedtls
		and licensed under Apache-2.0.
```

## mqtt_pubsub/Kconfig
```kconfig
#
# For a description of the syntax of this configuration file,
# see the file kconfig-language.txt in the NuttX tools repository.
#

config EXTERNALS_MQTT_PUBSUB
	bool "MQTT pub/sub test application"
	default n
```
